## CMakeLists.txt
```
cmake_minimum_required(VERSION 3.20.0)

set(BOARD nrf52840dongle_nrf52840)

set(OSLIB_DIR ../../oslib/)
set(EXT_LIB_DIR ../../extlib/)
set(LED_DRIVER_LIB_DIR ${OSLIB_DIR}/led)
set(BASE_NODE_DRIVER_LIB_DIR ${OSLIB_DIR}/base)
set(SHELL_LIB_DIR ${BASE_NODE_DRIVER_LIB_DIR}/shell)
set(BLE_DRIVER_LIB_DIR ${BASE_NODE_DRIVER_LIB_DIR}/ble)
set(HCI_LIB_DIR ${BASE_NODE_DRIVER_LIB_DIR}/hci)

add_compile_options(
  -Wall
  -Wextra
  -Wno-discarded-qualifiers
  -Wno-sign-compare
  -Wno-unused-variable
  -Wno-unused-parameter
  -Wno-cast-function-type
  -Wno-missing-field-initializers
  -Wno-type-limits
  -pipe
  -ggdb3
  -Og
)

set(CONF_FILE
    prj.conf
    ${OSLIB_DIR}/usb/usb.conf
    ${SHELL_LIB_DIR}/shell.conf
    ${BLE_DRIVER_LIB_DIR}/ble.conf
)

set(DTC_OVERLAY_FILE
    ${SHELL_LIB_DIR}/shell.overlay
)

find_package(Zephyr REQUIRED HINTS $ENV{ZEPHYR_BASE})
project(icarus-yellow-base)

#Add Include Directories
include_directories(
    ${LED_DRIVER_LIB_DIR}
    ${SHELL_LIB_DIR}
    ${BLE_DRIVER_LIB_DIR}
    ${HCI_LIB_DIR}
    ${MPU9250_LIB_DIR}
)

#Add Target Sources
target_sources(app PRIVATE
    src/main.c
    ${LED_DRIVER_LIB_DIR}/lib_led.c
    ${LED_DRIVER_LIB_DIR}/tsk_led.c
    ${SHELL_LIB_DIR}/ahu_led_cmd.c
    ${SHELL_LIB_DIR}/ahu_time_cmd.c
    ${SHELL_LIB_DIR}/ahu_ble_hts221_cmd.c
    ${SHELL_LIB_DIR}/ahu_ble_lis2dh_cmd.c
    ${SHELL_LIB_DIR}/ahu_ble_lps22_cmd.c
    ${SHELL_LIB_DIR}/ahu_ble_ccs811_cmd.c
    ${SHELL_LIB_DIR}/ahu_ble_pushbutton_cmd.c
    ${SHELL_LIB_DIR}/ahu_ble_buzzer_cmd.c
    ${SHELL_LIB_DIR}/ahu_ble_rgb_cmd.c
    ${SHELL_LIB_DIR}/ahu_ble_dc_cmd.c
    ${SHELL_LIB_DIR}/ahu_ble_sample_cmd.c
    ${SHELL_LIB_DIR}/ahu_ble_all_cmd.c
    ${SHELL_LIB_DIR}/lib_shell.c
    ${HCI_LIB_DIR}/lib_hci.c
    ${BLE_DRIVER_LIB_DIR}/tsk_ble.c
    #${MPU9250_LIB_DIR}/inv_mpu_dmp_motion_driver.c
    #${MPU9250_LIB_DIR}/inv_mpu.c
)
```

## prj.conf
```kconfig
CONFIG_GPIO=y

CONFIG_LOG_OVERRIDE_LEVEL=0
CONFIG_LOG_MAX_LEVEL=0
```

## src/main.c
```c
/*
 * Copyright (c) 2016 Intel Corporation
 *
 * SPDX-License-Identifier: Apache-2.0
 */


//#include <logging/log.h>

#include <zephyr.h>
#include <device.h>
#include <devicetree.h>
#include <drivers/gpio.h>
#include <usb/usb_device.h>
#include <drivers/uart.h>
#include "tsk_led.h"
#include "tsk_ble.h"
#include <logging/log.h>
#include "lib_shell.h"


/* 1000 msec = 1 sec */
#define SLEEP_TIME_MS   1000

LOG_MODULE_REGISTER(main_log_module, LOG_LEVEL_DBG);

void main(void) {

	/* Setup DTR */
    uint32_t dtr = 0;

    /* Enable the USB Driver */
    if (usb_enable(NULL))   
        return;
    
   /* Wait on DTR - 'Data Terminal Ready'
    * Will wait here until a terminal has been attached to the device
    * This is not necessary, however, can be useful for printing boot info etc..
    */
    while (!dtr) {
        uart_line_ctrl_get(shell_dev, UART_LINE_CTRL_DTR, &dtr);
        k_sleep(K_MSEC(50));
    }
    
    LOG_DBG("Shell initialised successfully!");

    k_tid_t led_ctrl_thread_id = led_ctrl_tsk_init();
    LOG_DBG("LED control thread started successfully!");

    k_tid_t ble_ctrl_thread_id = ble_ctrl_tsk_init();
    LOG_DBG("BLE control thread started successfully!");

    k_tid_t ble_led_ctrl_thread_id = ble_led_tsk_init();
    LOG_DBG("BLE status LED control thread started successfully!");

    return;
	
}
```
